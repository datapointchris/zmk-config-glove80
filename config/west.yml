## config/west.yml
```yaml
manifest:
  remotes:
    - name: moergo-sc
      url-base: https://github.com/moergo-sc
    - name: datapointchris
      url-base: https://github.com/datapointchris
  projects:
    - name: zmk
      remote: moergo-sc
      revision: main
      import: app/west.yml
    - name: zmk-shared
      remote: datapointchris
      revision: main
  self:
    path: config
```
